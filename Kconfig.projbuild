## Kconfig.projbuild
```kconfig
menu "KeyKeeper2"

    config KEYKEEPER_LITE
        bool "Build the Lite variant (strip paid-tier features)"
        default n
        help
            KeyKeeper2 ships as two variants from one codebase, feature-
            flagged rather than kept on a separate branch -- same
            precedent as excluding a whole component (see
            EXCLUDE_COMPONENTS in the top-level CMakeLists.txt for
            components/gui), just applied per-feature instead of
            per-component where a feature doesn't cleanly own its own
            component.

            When enabled, code behind "#if !CONFIG_KEYKEEPER_LITE" (C/
            C++) or "if(NOT CONFIG_KEYKEEPER_LITE)" (CMakeLists.txt) is
            compiled out of the build entirely -- not hidden at
            runtime behind a settings toggle the user could re-enable.
            See profiles/README.md for the exact build commands for
            each variant, and profiles/lite.defaults for the actual
            flag.

            Lite strips (tracked as each is actually wired up, not all
            landing in one commit): the dial-style PIN entry mode,
            on-device Backup, the password generator, display
            rotation, the Wi-Fi captive portal, and PIN hashing
            (reverted to the project's original single-pass salted
            SHA-256, no PBKDF2 stretching). None of these are security
            boundaries between the two variants -- Lite is a feature
            tier, not a reduced-trust build -- except PIN hashing
            specifically, which genuinely weakens offline brute-force
            resistance and is a deliberate, documented trade for a
            free/advertising tier, not an oversight.

endmenu
```

## components/kkproto/Kconfig.projbuild
```kconfig
menu "KeyKeeper2 secure radio link (kkproto)"

    config KEYKEEPER_KKPROTO
        bool "Build the kkproto library (Noise XX/IK link to a radio dongle)"
        default n
        help
            Builds components/kkproto: the portable protocol library for the encrypted link
            between the vault and a radio dongle (Noise XX pairing, Noise IK sessions, framing,
            messages, pairing code). It has no effect on the device until something calls it.

            Needs an mbedTLS configuration with X25519 (Curve25519), ChaCha20-Poly1305,
            SHA-256 and HMAC. kk::crypto::selftest() reports at run time if one is missing --
            call it once at boot of anything that uses the link.

            Off by default: nothing in the firmware depends on it yet.

endmenu
```

## components/wireless/Kconfig.projbuild
```kconfig
menu "KeyKeeper2 wireless typing"

    config WIRELESS_TRANSPORT_BLE
        bool "Talk to the dongle over BLE instead of the UART cable"
        depends on KEYKEEPER_KKPROTO
        default n
        help
            On: the vault finds and connects to its dongle over Bluetooth LE (component blelink, NimBLE). Pairing
            looks for a dongle whose pairing window is open; afterwards the vault reconnects to the paired dongle's
            address by itself.

            Needs the NimBLE host in sdkconfig: CONFIG_BT_ENABLED=y, CONFIG_BT_NIMBLE_ENABLED=y,
            CONFIG_BT_BLUEDROID_ENABLED=n, CONFIG_BT_NIMBLE_ATT_PREFERRED_MTU=247 (see components/blelink/README.md).

            Off (default): the UART cable between the boards (GPIO10 TX / GPIO11 RX).

endmenu
```

## dongle/main/Kconfig.projbuild
```kconfig
menu "Dongle"

    choice DONGLE_ROLE
        prompt "What this firmware is"
        default DONGLE_ROLE_DONGLE

        config DONGLE_ROLE_DONGLE
            bool "Dongle (waits for the vault)"

        config DONGLE_ROLE_VAULT_SIM
            bool "Vault simulator (for testing the dongle; starts pairings and connects)"
    endchoice

    config DONGLE_USB_HID
        bool "Dongle: act as a real USB keyboard (USB composite: keyboard + serial port for logs)"
        depends on DONGLE_ROLE_DONGLE
        default n
        help
            Off: the dongle only logs the keys it would press (and the board's USB port stays the console).
            On (use sdkconfig.hid): the USB port belongs to TinyUSB. The PC sees a keyboard and a serial port;
            the log is written to that serial port (and to UART0).

    config DONGLE_TRANSPORT_BLE
        bool "Dongle: talk to the vault over BLE instead of the UART cable"
        depends on DONGLE_ROLE_DONGLE
        default n
        help
            On (use sdkconfig.ble, which also switches NimBLE on): the dongle advertises and the vault connects
            to it by itself; the UART is not used. Off: the UART cable of stage 3.

    config DONGLE_UART_NUM
        int "UART controller for the link (1 or 2; 0 is the console)"
        range 1 2
        default 1

    config DONGLE_TX_PIN
        int "TX GPIO"
        range 0 48
        default 10
        help
            Same pins as the wiring test (tools/uart_link_test): TX of one board goes to RX of the other.

    config DONGLE_RX_PIN
        int "RX GPIO"
        range 0 48
        default 11

    config DONGLE_BAUD
        int "Baud rate"
        range 9600 2000000
        default 460800

    config DONGLE_PAIRING_WINDOW_S
        int "Dongle: how long a pairing stays open after BOOT (seconds)"
        range 10 600
        default 60

    config DONGLE_LANGUAGE_RU
        bool "Screen text in Russian"
        default y
        help
            Language used until the vault tells the dongle its own (the vault sends its menu language when they connect; the dongle remembers it).

    config DONGLE_SCREEN_TIMEOUT_S
        int "Backlight off after this many seconds without activity (0 = always on)"
        range 0 3600
        default 20
        help
            Typing, a BOOT press and any change of what the screen says (pairing, connecting) switch it on again.

endmenu
```

## tools/ble_link_test/main/Kconfig.projbuild
```kconfig
menu "BLE link test"

    choice BLE_TEST_ROLE
        prompt "Role of this board"
        default BLE_TEST_ROLE_PERIPHERAL

        config BLE_TEST_ROLE_PERIPHERAL
            bool "Peripheral (advertises, echoes messages back) - plays the dongle"

        config BLE_TEST_ROLE_CENTRAL
            bool "Central (scans, connects, sends test messages) - plays the vault"
    endchoice

    config BLE_TEST_PERIOD_MS
        int "Central: pause between test messages, ms"
        range 0 5000
        default 100

    config BLE_TEST_CONN_ITVL_MIN
        int "Central: connection interval min (units of 1.25 ms)"
        range 6 3200
        default 12

    config BLE_TEST_CONN_ITVL_MAX
        int "Central: connection interval max (units of 1.25 ms)"
        range 6 3200
        default 24

endmenu
```

## tools/pairing_test/main/Kconfig.projbuild
```kconfig
menu "Pairing test"

    config PAIRING_TEST_UART_NUM
        int "UART controller (1 or 2; 0 is the console)"
        range 1 2
        default 1

    config PAIRING_TEST_TX_PIN
        int "TX GPIO"
        range 0 48
        default 10
        help
            Same pins as the wiring test (tools/uart_link_test): TX of one board goes to RX of the other.

    config PAIRING_TEST_RX_PIN
        int "RX GPIO"
        range 0 48
        default 11

    config PAIRING_TEST_BAUD
        int "Baud rate"
        range 9600 2000000
        default 460800

    config PAIRING_TEST_RETRY_MS
        int "Initiator: restart the handshake after this many ms without progress"
        range 100 10000
        default 1000

    config PAIRING_TEST_MAX_ATTEMPTS
        int "Initiator: give up after this many handshakes"
        range 1 100
        default 8

endmenu
```

## tools/uart_link_test/main/Kconfig.projbuild
```kconfig
menu "UART link test"

    config UART_LINK_TEST_UART_NUM
        int "UART controller (1 or 2; 0 is the console)"
        range 1 2
        default 1

    config UART_LINK_TEST_TX_PIN
        int "TX GPIO"
        range 0 48
        default 10
        help
            Free header pin on the Waveshare ESP32-S3-LCD-1.47B (see components/bsp/include/bsp/pins.hpp).
            Wire it to the RX pin of the OTHER board.

    config UART_LINK_TEST_RX_PIN
        int "RX GPIO"
        range 0 48
        default 11
        help
            Wire it to the TX pin of the OTHER board.

    config UART_LINK_TEST_BAUD
        int "Baud rate"
        range 9600 2000000
        default 460800

    config UART_LINK_TEST_PAYLOAD_LEN
        int "Ping payload length in bytes"
        range 10 120
        default 24
        help
            10 is the minimum. Use 96 to imitate the biggest handshake messages.

    config UART_LINK_TEST_PERIOD_MS
        int "Send one ping every N milliseconds"
        range 10 5000
        default 200

endmenu
```
